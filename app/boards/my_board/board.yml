## app/boards/my_board/board.yml
```yaml
board:
  name: my_board
  full_name: My Board From Scratch
  vendor: arya
  socs:
    - name: stm32l476xx
```

## app/boards/our_board/board.yml
```yaml
board:
  name: our_board
  full_name: Nucleo L476RG
  vendor: arya
  socs:
    - name: stm32l476xx
```
